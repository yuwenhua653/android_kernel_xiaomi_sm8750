## drivers/input/fingerprint/mi_fp/Kconfig
```kconfig
# SPDX-License-Identifier: GPL-2.0-only
config FINGERPRINT_MI_FP
	tristate "Xiaomi Annibale P11 fingerprint (experimental)"
	depends on EXPERT && INPUT && OF && GPIOLIB && REGULATOR && NET
	depends on MI_HARDWARE_ID && QCOM_PANEL_EVENT_NOTIFIER && DRM_PANEL
	help
	  Compile the MiCode P11 platform, IPC and userspace interface candidate.
	  This port is not yet qualified for deployment: remaining lifetime,
	  suspend and HAL/TEE behavior need validation. Leave disabled normally.
	  The module is named mi_fp. Only the Annibale P11 variant is supported.

config ULTRA_FINGERPRINT_P11
	bool
	default y if FINGERPRINT_MI_FP
```

## drivers/misc/wifi_gpio/Kconfig
```kconfig
# SPDX-License-Identifier: GPL-2.0-only
config MI_WIFI_GPIO
	tristate "Xiaomi Wi-Fi SAR GPIO"
	depends on OF && GPIOLIB && NET && MI_HARDWARE_ID
	help
	  Report the board SAR GPIO through the Xiaomi wifi_sar netlink family.
	  Only boards identified as Chinese by supplied HWID parameters bind.
	  This is the SAR notification interface, not the WLAN radio driver.
	  To build a module, choose M; it is called xiaomi_wifi_gpio.
```

## drivers/power/supply/mca/Kconfig
```kconfig
# SPDX-License-Identifier: GPL-2.0-only
config XIAOMI_MCA_CORE
	tristate "Annibale MCA common helpers (experimental)"
	depends on EXPERT && OF && MI_HARDWARE_ID
	help
	  Build the MCA device-tree parser, hardware identity and workqueue.
	  These are common helpers, not a battery supply or charging policy.
	  Leave disabled until the remaining Annibale charging stack is ready.

config XIAOMI_MCA_GLINK
	tristate "Annibale MCA ADSP transport (experimental)"
	depends on XIAOMI_MCA_CORE && QTI_PMIC_GLINK
	depends on QTI_BATTERY_CHARGER=n
	help
	  Build the two-owner MCA charging/auxiliary PMIC Glink transport.
	  This occupies the same owners as the standard battery charger client.
	  It must not be selected alongside that client. No charging strategy
	  or current/voltage policy is enabled by this transport alone.

config XIAOMI_MCA_SERVICES
	tristate "Annibale MCA charging and fuel-gauge interfaces (experimental)"
	depends on XIAOMI_MCA_CORE && SYSFS
	help
	  Build the xm_power sysfs namespace, event notifications, charging
	  control dispatcher and fuel-gauge callback registry. These require
	  real hardware/policy providers; missing operations return errors.
	  No battery power-supply driver or charging policy is supplied here.

config XIAOMI_MCA_BQ27Z561
	tristate "Annibale BQ27Z561 read-only telemetry (experimental)"
	depends on XIAOMI_MCA_SERVICES && I2C
	help
	  Read standard gauge registers on the Annibale master gauge at 0x55.
	  Publish measured values through MCA and read-only I2C device sysfs.
	  No battery power_supply, polling, firmware writes or charging policy.
	  Do not load alongside the stock gauge driver. Leave disabled outside
	  explicit development builds until pack variants are tested on hardware.
```

## drivers/staging/mi_rmap_efficiency/Kconfig
```kconfig
config MI_RMAP_EFFICIENCY
    tristate "support MI_RMAP_EFFICIENCY module"
    depends on ANDROID_VENDOR_HOOKS && ANDROID_VENDOR_OEM_DATA
    depends on m
    default n
    help
        skip __mapcount pages to reduce CPU load caused by reverse mapping during mem recycling.
```

## drivers/xiaomi/bootmonitor/Kconfig
```kconfig
# SPDX-License-Identifier: GPL-2.0-only
#
# Mi boot monitor
#

config MI_BOOT_MONITOR
	tristate "boot monitor"
	depends on MI_BOOT_TIME && BLOCK && PROC_FS && OF
	default n
	help
	This adds support for mi boot monitor.
```

## drivers/xiaomi/boottime/Kconfig
```kconfig
# SPDX-License-Identifier: GPL-2.0-only
#
# Mi boot time
#

config MI_BOOT_TIME
	tristate "boot time record"
	depends on PROC_FS && TRACEPOINTS
	default n
	help
	This adds support for mi boot time.
```

## drivers/xiaomi/kshrink_slabd/Kconfig
```kconfig
config KSHRINK_SLABD
       tristate "Allow asynchronous shrink slab"
       depends on ANDROID_VENDOR_HOOKS && MEMCG
       default n
       help
         Asynchronous shrink slab memload optimization feature
```

## drivers/xiaomi/mi_stack/Kconfig
```kconfig
# SPDX-License-Identifier: GPL-2.0-only

config MI_STACK
	tristate "mi_stack support"
	depends on ARM64 && PROC_FS && STACKTRACE
	default n
	help
		mi stack will show kernel stacktrace of the specified task.
```

## drivers/xiaomi/mi_trace/Kconfig
```kconfig
# SPDX-License-Identifier: GPL-2.0-only

config MI_TRACE
	tristate "mi_trace support"
	depends on PROC_FS && TRACEPOINTS && QCOM_MINIDUMP
	default n
	help
		mi trace will record irq and schedule trace log.
```

## drivers/xiaomi/mi_ubt/test/Kconfig
```kconfig
# SPDX-License-Identifier: GPL-2.0-only

config MI_UBT_TEST
	tristate "mi_ubt_test support"
	depends on MI_UBT && PROC_FS
	default n
	help
		mi_ubt_test will show user that how to use mi_ubt.
```

## drivers/xiaomi/swinfo/Kconfig
```kconfig
# SPDX-License-Identifier: GPL-2.0-only

config MI_SOFTWARE_INFO
	tristate "export software information"
	depends on PROC_FS && QCOM_MINIDUMP
	default n
	help
		swinfo provide the function of exported software information (such as .config).
```
